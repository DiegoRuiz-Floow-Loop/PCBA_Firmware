
/* XI: EXTERN INTERRUPT */
#define MP_GSM_STATUS                                      MCUPIN(XI_GSM_STATUS_GPIO_Port, XI_GSM_STATUS_Pin)
#define MP_ITEM_IN_1                                       MCUPIN(XI_ITEM_IN_1_GPIO_Port, XI_ITEM_IN_1_Pin)
#define MP_ITEM_IN_2                                       MCUPIN(XI_ITEM_IN_2_GPIO_Port, XI_ITEM_IN_2_Pin)
#define MP_ITEM_IN_3                                       MCUPIN(XI_ITEM_IN_3_GPIO_Port, XI_ITEM_IN_3_Pin)
#define MP_ITEM_IN_4                                       MCUPIN(XI_ITEM_IN_4_GPIO_Port, XI_ITEM_IN_4_Pin)
#define MP_ITEM_IN_5                                       MCUPIN(XI_ITEM_IN_5_GPIO_Port, XI_ITEM_IN_5_Pin)
#define MP_USER_BTN                                        MCUPIN(XI_USER_BTN_GPIO_Port, XI_USER_BTN_Pin)

/* DI: DIGITALE INPUT */
#define MP_CONFIG_0                                        MCUPIN(DI_CONFIG_0_GPIO_Port, DI_CONFIG_0_Pin)
#define MP_CONFIG_1                                        MCUPIN(DI_CONFIG_1_GPIO_Port, DI_CONFIG_1_Pin)
#define MP_HWREV_0                                         MCUPIN(DI_HWREV_0_GPIO_Port, DI_HWREV_0_Pin)
#define MP_HWREV_1                                         MCUPIN(DI_HWREV_1_GPIO_Port, DI_HWREV_1_Pin)
#define MP_PWR_SEL                                         MCUPIN(DI_PWR_SEL_GPIO_Port, DI_PWR_SEL_Pin)

/* DO: DIGITALE OUTPUT */
#define MP_DC_DC_EN                                        MCUPIN(DO_DC_DC_EN_GPIO_Port, DO_DC_DC_EN_Pin)
#define MP_EN_MEASURE                                      MCUPIN(DO_EN_MEASURE_GPIO_Port, DO_EN_MEASURE_Pin)
#define MP_EXT_LOG_SEL                                     MCUPIN(DO_EXT_LOG_SEL_GPIO_Port, DO_EXT_LOG_SEL_Pin)
#define MP_EXT_POWER_ENABLE                                MCUPIN(DO_EXT_POWER_ENABLE_GPIO_Port, DO_EXT_POWER_ENABLE_Pin)
#define MP_GSM_PWR_KEY                                     MCUPIN(DO_GSM_PWR_KEY_GPIO_Port, DO_GSM_PWR_KEY_Pin)
#define MP_ITEM_OUT_1                                      MCUPIN(DO_ITEM_OUT_1_GPIO_Port, DO_ITEM_OUT_1_Pin)
#define MP_ITEM_OUT_2                                      MCUPIN(DO_ITEM_OUT_2_GPIO_Port, DO_ITEM_OUT_2_Pin)
#define MP_ITEM_OUT_3_N                                    MCUPIN(DO_ITEM_OUT_3_N_GPIO_Port, DO_ITEM_OUT_3_N_Pin)
#define MP_ITEM_OUT_3_P                                    MCUPIN(DO_ITEM_OUT_3_P_GPIO_Port, DO_ITEM_OUT_3_P_Pin)
#define MP_ITEM_OUT_4_N                                    MCUPIN(DO_ITEM_OUT_4_N_GPIO_Port, DO_ITEM_OUT_4_N_Pin)
#define MP_ITEM_OUT_4_P                                    MCUPIN(DO_ITEM_OUT_4_P_GPIO_Port, DO_ITEM_OUT_4_P_Pin)
#define MP_ITEM_OUT_5_N                                    MCUPIN(DO_ITEM_OUT_5_N_GPIO_Port, DO_ITEM_OUT_5_N_Pin)
#define MP_ITEM_OUT_5_P                                    MCUPIN(DO_ITEM_OUT_5_P_GPIO_Port, DO_ITEM_OUT_5_P_Pin)
#define MP_LED_GREEN                                       MCUPIN(DO_LED_GREEN_GPIO_Port, DO_LED_GREEN_Pin)
#define MP_LED_RGB_B                                       MCUPIN(DO_LED_RGB_B_GPIO_Port, DO_LED_RGB_B_Pin)
#define MP_LED_RGB_G                                       MCUPIN(DO_LED_RGB_G_GPIO_Port, DO_LED_RGB_G_Pin)
#define MP_LED_RGB_R                                       MCUPIN(DO_LED_RGB_R_GPIO_Port, DO_LED_RGB_R_Pin)
#define MP_MEM_PWR_EN                                      MCUPIN(DO_MEM_PWR_EN_GPIO_Port, DO_MEM_PWR_EN_Pin)
#define MP_SPI_DFLASH_CS                                   MCUPIN(DO_SPI_DFLASH_CS_GPIO_Port, DO_SPI_DFLASH_CS_Pin)

/* OO: DIGITALE OPEN DRAIN OUTPUT */
