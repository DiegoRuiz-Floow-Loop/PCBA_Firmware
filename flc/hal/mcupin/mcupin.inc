
/* XI: EXTERN INTERRUPT */
#define MP_MDM_STATUS                                      MCUPIN(XI_MDM_STATUS_GPIO_Port, XI_MDM_STATUS_Pin)
#define MP_PUMP_FAULT1                                     MCUPIN(XI_PUMP_FAULT1_GPIO_Port, XI_PUMP_FAULT1_Pin)
#define MP_PUMP_FAULT2                                     MCUPIN(XI_PUMP_FAULT2_GPIO_Port, XI_PUMP_FAULT2_Pin)
#define MP_PUMP_FAULT3                                     MCUPIN(XI_PUMP_FAULT3_GPIO_Port, XI_PUMP_FAULT3_Pin)
#define MP_PWR_FAULT_24V                                   MCUPIN(XI_PWR_FAULT_24V_GPIO_Port, XI_PWR_FAULT_24V_Pin)
#define MP_PWR_FAULT_CUR                                   MCUPIN(XI_PWR_FAULT_CUR_GPIO_Port, XI_PWR_FAULT_CUR_Pin)
#define MP_PWR_FAULT_FU                                    MCUPIN(XI_PWR_FAULT_FU_GPIO_Port, XI_PWR_FAULT_FU_Pin)
#define MP_PWR_FAULT_SENS                                  MCUPIN(XI_PWR_FAULT_SENS_GPIO_Port, XI_PWR_FAULT_SENS_Pin)

/* DI: DIGITALE INPUT */
#define MP_BTN_1_NC                                        MCUPIN(DI_BTN_1_NC_GPIO_Port, DI_BTN_1_NC_Pin)
#define MP_BTN_1_NO                                        MCUPIN(DI_BTN_1_NO_GPIO_Port, DI_BTN_1_NO_Pin)
#define MP_BTN_2_NC                                        MCUPIN(DI_BTN_2_NC_GPIO_Port, DI_BTN_2_NC_Pin)
#define MP_BTN_2_NO                                        MCUPIN(DI_BTN_2_NO_GPIO_Port, DI_BTN_2_NO_Pin)
#define MP_HW_CFG0                                         MCUPIN(DI_HW_CFG0_GPIO_Port, DI_HW_CFG0_Pin)
#define MP_HW_CFG1                                         MCUPIN(DI_HW_CFG1_GPIO_Port, DI_HW_CFG1_Pin)
#define MP_HW_REV0                                         MCUPIN(DI_HW_REV0_GPIO_Port, DI_HW_REV0_Pin)
#define MP_HW_REV1                                         MCUPIN(DI_HW_REV1_GPIO_Port, DI_HW_REV1_Pin)
#define MP_SENSOR16D                                       MCUPIN(DI_SENSOR16D_GPIO_Port, DI_SENSOR16D_Pin)
#define MP_SENSOR17D                                       MCUPIN(DI_SENSOR17D_GPIO_Port, DI_SENSOR17D_Pin)
#define MP_SENSOR18D                                       MCUPIN(DI_SENSOR18D_GPIO_Port, DI_SENSOR18D_Pin)
#define MP_TANK_SENSOR1                                    MCUPIN(DI_TANK_SENSOR1_GPIO_Port, DI_TANK_SENSOR1_Pin)
#define MP_TANK_SENSOR2                                    MCUPIN(DI_TANK_SENSOR2_GPIO_Port, DI_TANK_SENSOR2_Pin)
#define MP_TANK_SENSOR3                                    MCUPIN(DI_TANK_SENSOR3_GPIO_Port, DI_TANK_SENSOR3_Pin)
#define MP_TANK_SENSOR4                                    MCUPIN(DI_TANK_SENSOR4_GPIO_Port, DI_TANK_SENSOR4_Pin)
#define MP_TANK_SENSOR5                                    MCUPIN(DI_TANK_SENSOR5_GPIO_Port, DI_TANK_SENSOR5_Pin)
#define MP_UV_ON                                           MCUPIN(DI_UV_ON_GPIO_Port, DI_UV_ON_Pin)

/* DO: DIGITALE OUTPUT */
#define MP_A_MUX_SEL                                       MCUPIN(DO_A_MUX_SEL_GPIO_Port, DO_A_MUX_SEL_Pin)
#define MP_BTN_1_LIGHT                                     MCUPIN(DO_BTN_1_LIGHT_GPIO_Port, DO_BTN_1_LIGHT_Pin)
#define MP_BTN_2_LIGHT                                     MCUPIN(DO_BTN_2_LIGHT_GPIO_Port, DO_BTN_2_LIGHT_Pin)
#define MP_DBG_LED_HB                                      MCUPIN(DO_DBG_LED_HB_GPIO_Port, DO_DBG_LED_HB_Pin)
#define MP_LED_EXTRA1                                      MCUPIN(DO_LED_EXTRA1_GPIO_Port, DO_LED_EXTRA1_Pin)
#define MP_MDM_PWR_KEY                                     MCUPIN(DO_MDM_PWR_KEY_GPIO_Port, DO_MDM_PWR_KEY_Pin)
#define MP_MEASURE_EN                                      MCUPIN(DO_MEASURE_EN_GPIO_Port, DO_MEASURE_EN_Pin)
#define MP_MEM_RST                                         MCUPIN(DO_MEM_RST_GPIO_Port, DO_MEM_RST_Pin)
#define MP_nCS_FLASH                                       MCUPIN(DO_nCS_FLASH_GPIO_Port, DO_nCS_FLASH_Pin)
#define MP_nCS_FRAM                                        MCUPIN(DO_nCS_FRAM_GPIO_Port, DO_nCS_FRAM_Pin)
#define MP_PUMP_DIR1                                       MCUPIN(DO_PUMP_DIR1_GPIO_Port, DO_PUMP_DIR1_Pin)
#define MP_PUMP_DIR2                                       MCUPIN(DO_PUMP_DIR2_GPIO_Port, DO_PUMP_DIR2_Pin)
#define MP_PUMP_DIR3                                       MCUPIN(DO_PUMP_DIR3_GPIO_Port, DO_PUMP_DIR3_Pin)
#define MP_PWR_EN_24VSENS                                  MCUPIN(DO_PWR_EN_24VSENS_GPIO_Port, DO_PWR_EN_24VSENS_Pin)
#define MP_PWR_EN_5V                                       MCUPIN(DO_PWR_EN_5V_GPIO_Port, DO_PWR_EN_5V_Pin)
#define MP_PWR_EN_5VSENS                                   MCUPIN(DO_PWR_EN_5VSENS_GPIO_Port, DO_PWR_EN_5VSENS_Pin)
#define MP_PWR_EN_FU                                       MCUPIN(DO_PWR_EN_FU_GPIO_Port, DO_PWR_EN_FU_Pin)
#define MP_PWR_EN_MEM                                      MCUPIN(DO_PWR_EN_MEM_GPIO_Port, DO_PWR_EN_MEM_Pin)
#define MP_PWR_EN_MMI                                      MCUPIN(DO_PWR_EN_MMI_GPIO_Port, DO_PWR_EN_MMI_Pin)
#define MP_PWR_EN_MODEM                                    MCUPIN(DO_PWR_EN_MODEM_GPIO_Port, DO_PWR_EN_MODEM_Pin)
#define MP_PWR_EN_POS                                      MCUPIN(DO_PWR_EN_POS_GPIO_Port, DO_PWR_EN_POS_Pin)
#define MP_PWR_EN_PUMP1                                    MCUPIN(DO_PWR_EN_PUMP1_GPIO_Port, DO_PWR_EN_PUMP1_Pin)
#define MP_PWR_EN_PUMP2                                    MCUPIN(DO_PWR_EN_PUMP2_GPIO_Port, DO_PWR_EN_PUMP2_Pin)
#define MP_PWR_EN_PUMP3                                    MCUPIN(DO_PWR_EN_PUMP3_GPIO_Port, DO_PWR_EN_PUMP3_Pin)
#define MP_PWR_EN_UV                                       MCUPIN(DO_PWR_EN_UV_GPIO_Port, DO_PWR_EN_UV_Pin)
#define MP_PWR_EN_VALVE                                    MCUPIN(DO_PWR_EN_VALVE_GPIO_Port, DO_PWR_EN_VALVE_Pin)
#define MP_SENSOR1_SEL                                     MCUPIN(DO_SENSOR1_SEL_GPIO_Port, DO_SENSOR1_SEL_Pin)
#define MP_SENSOR16_SEL                                    MCUPIN(DO_SENSOR16_SEL_GPIO_Port, DO_SENSOR16_SEL_Pin)
#define MP_SENSOR17_SEL                                    MCUPIN(DO_SENSOR17_SEL_GPIO_Port, DO_SENSOR17_SEL_Pin)
#define MP_SENSOR18_SEL                                    MCUPIN(DO_SENSOR18_SEL_GPIO_Port, DO_SENSOR18_SEL_Pin)
#define MP_SENSOR2_SEL                                     MCUPIN(DO_SENSOR2_SEL_GPIO_Port, DO_SENSOR2_SEL_Pin)
#define MP_SENSOR3_SEL                                     MCUPIN(DO_SENSOR3_SEL_GPIO_Port, DO_SENSOR3_SEL_Pin)
#define MP_SENSOR4_SEL                                     MCUPIN(DO_SENSOR4_SEL_GPIO_Port, DO_SENSOR4_SEL_Pin)
#define MP_SENSOR5_SEL                                     MCUPIN(DO_SENSOR5_SEL_GPIO_Port, DO_SENSOR5_SEL_Pin)
#define MP_SENSOR6_SEL                                     MCUPIN(DO_SENSOR6_SEL_GPIO_Port, DO_SENSOR6_SEL_Pin)
#define MP_SENSOR7_SEL                                     MCUPIN(DO_SENSOR7_SEL_GPIO_Port, DO_SENSOR7_SEL_Pin)

/* OO: DIGITALE OPEN DRAIN OUTPUT */
