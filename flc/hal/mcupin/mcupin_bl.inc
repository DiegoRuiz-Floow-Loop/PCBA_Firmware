
/* XI: EXTERN INTERRUPT */

/* DI: DIGITALE INPUT */
#define MP_HW_CFG0                                         MCUPIN(DI_HW_CFG0_GPIO_Port, DI_HW_CFG0_Pin)
#define MP_HW_CFG1                                         MCUPIN(DI_HW_CFG1_GPIO_Port, DI_HW_CFG1_Pin)
#define MP_HW_REV0                                         MCUPIN(DI_HW_REV0_GPIO_Port, DI_HW_REV0_Pin)
#define MP_HW_REV1                                         MCUPIN(DI_HW_REV1_GPIO_Port, DI_HW_REV1_Pin)

/* DO: DIGITALE OUTPUT */
#define MP_DBG_LED_HB                                      MCUPIN(DO_DBG_LED_HB_GPIO_Port, DO_DBG_LED_HB_Pin)
#define MP_MEM_RST                                         MCUPIN(DO_MEM_RST_GPIO_Port, DO_MEM_RST_Pin)
#define MP_nCS_FLASH                                       MCUPIN(DO_nCS_FLASH_GPIO_Port, DO_nCS_FLASH_Pin)
#define MP_PWR_EN_MEM                                      MCUPIN(DO_PWR_EN_MEM_GPIO_Port, DO_PWR_EN_MEM_Pin)

/* OO: DIGITALE OPEN DRAIN OUTPUT */
